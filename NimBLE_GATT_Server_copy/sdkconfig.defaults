## NimBLE_GATT_Server_copy/sdkconfig.defaults
```kconfig
CONFIG_BT_ENABLED=y
CONFIG_BT_NIMBLE_ENABLED=y
CONFIG_BT_NIMBLE_50_FEATURE_SUPPORT=n

CONFIG_BLINK_LED_GPIO=y
CONFIG_BLINK_GPIO=8

# Disable component manager to avoid network issues
CONFIG_IDF_COMPONENT_MANAGER=n
```

## NimBLE_GATT_Server_copy/sdkconfig.defaults.esp32s3
```kconfig
CONFIG_BLINK_LED_STRIP=y
CONFIG_BLINK_GPIO=48
CONFIG_ESPTOOLPY_FLASHSIZE_8MB=y
CONFIG_PARTITION_TABLE_CUSTOM=y
```
